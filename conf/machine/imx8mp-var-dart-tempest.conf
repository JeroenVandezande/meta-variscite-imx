## conf/machine/imx8mp-var-dart-tempest.conf
```bitbake
#@TYPE: Machine
#@NAME: Variscite DART-MX8M-PLUS On Torrent
#@SOC: i.MX8MP
#@DESCRIPTION: Machine configuration for Variscite DART-MX8M-PLUS On Torrent X-Head
#@MAINTAINER: Jeroen Vandezande <Jeroen@Orendes.be>

require conf/machine/imx8mp-var-dart.conf

MACHINEOVERRIDES_EXTENDER_imx8mp-var-dart-tempest = "imx8mp-var-dart"

KERNEL_DEVICETREE = " freescale/imx8mp-var-dart-tempest.dtb "
```
